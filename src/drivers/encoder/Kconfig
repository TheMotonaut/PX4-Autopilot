## src/drivers/encoder/Kconfig
```kconfig
menu "Encoders"
    menuconfig COMMON_ENCODERS
        bool "Common encoders"
        default n
        select DRIVERS_ENCODERS_AS5600
        select DRIVERS_ENCODERS_AEAT9955
        ---help---
            Enable default set of encoders

    rsource "*/Kconfig"
endmenu
```

## src/drivers/encoder/aeat9955/Kconfig
```kconfig
menuconfig DRIVERS_ENCODER_AEAT9955
	bool "aeat9955"
	default n
	---help---
		Enable support for magnetic encoder aeat9955
```

## src/drivers/encoder/as5600/Kconfig
```kconfig
menuconfig DRIVERS_ENCODER_AS5600
	bool "as5600"
	default n
	---help---
		Enable support for magnetic encoder as5600
```
