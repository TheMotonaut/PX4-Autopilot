## src/drivers/osd/flexio_osd/Kconfig
```kconfig
menuconfig DRIVERS_OSD_FLEXIO_OSD
	bool "flexio_osd"
	default n
	---help---
		Enable support for the analog video OSD generated by FlexIO on NXP i.MX RT boards
```
